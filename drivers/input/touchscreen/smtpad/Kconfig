## drivers/input/touchscreen/smtpad/Kconfig
```kconfig
#
# lenovo virtual smart pad driver configuration
#
config LENOVO_SMART_PAD_SUPPORT
	bool "lenovo smart pad support"
	default y
	help
	  Say Y here if smart pad is supported

	  If unsure, say N.
```

## drivers/misc/intel-ish/Kconfig
```kconfig
config INTEL_ISH
	tristate "Intel Integrated Sensor Hub"
	depends on X86 && PCI
	help
	  ISH enables sensors hub functionality on SoC/chipset level.
	  Integrated Sensor Hub (ISH) allows connecting and streaming
	  many sensors at once, adding algorithms (as custom sensors)
	  and saving power by offloading sensors polling and algorithms
	  to low-power complex in chipset.

	  ISH can operate in low-power system modes and can aggregate
	  sensors data in batches, optionally also providing wake event
	  to CPU (wake sensors functionality).

	  Chips that include ISH support: Cherrytrail, Skylake, Broxton

config ISH_PATH_SENSCOL
	tristate "ISH path through sensor-collection"
	depends on INTEL_ISH
	help
	  Enables sensor-collection path for ISH
	  Sensor-collection is a collection (hub) interface exposed to
	  user-mode with multiplexed data and possibly aggregated properties
	  setting/reading. Interface is provided through file/device POSIX
	  system calls.

	  Through sensor-collection custom sensors may be added only in
	  firmware, no modification of kernel code is necessary; once sensor
	  algorithm is added in firmware it will automatically expose to
	  user-mode.

	  Disable sensor-collection path if you want to expose a different
	  interface to user-mode, such as IIO
```
